// SPDX-License-Identifier: (GPL-2.0+ OR MIT)
/*
 * Copyright (c) 2021 Rockchip Electronics Co., Ltd.
 *
 */

/dts-v1/;

#include "rk3588-bpi-w3-bsp-common.dtsi"
#include "rk3588-linux.dtsi"

/ {
	model = "Banana Pi BPI-W3 (RK3588) 20220812";
	compatible = "rockchip,rk3588-bpi-w3-bsp", "rockchip,rk3588";
};

&sdmmc {
        max-frequency = <150000000>;
        /*no-sdio;*/
        /*no-mmc;*/
        bus-width = <4>;
        cap-mmc-highspeed;
        cap-sd-highspeed;
        disable-wp;
        /*sd-uhs-sdr104;*/
        supports-sd;
        vqmmc-supply = <&vccio_sd_s0>;
        status = "okay";
};
